## components/app_cfg/Kconfig
```kconfig
menu "App Settings"
    config APP_AP_SSID_PREFIX
        string "Setup AP SSID prefix"
        default "ESP-SETUP-"

    config APP_AP_PASSWORD
        string "Setup AP password (>=8 chars; empty=open)"
        default "12345678"

    config APP_BUTTON_GPIO
        int "Setup/reset button GPIO"
        default 0

    config APP_BUTTON_LONG_MS
        int "Long-press duration to erase creds (ms)"
        default 3000
        range 500 10000
endmenu
```
